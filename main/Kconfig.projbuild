## main/Kconfig.projbuild
```kconfig
menu "Wintermute display"
    choice WINTERMUTE_DISPLAY_MODE
        prompt "Display application"
        default WINTERMUTE_DISPLAY_LVGL

        config WINTERMUTE_DISPLAY_LVGL
            bool "LVGL display, touch, SD card and vibration test"

        config WINTERMUTE_DISPLAY_DIAGNOSTIC
            bool "Raw panel diagnostic (black/white/gray/partial)"
    endchoice
endmenu
```

## sdkconfig.defaults
```kconfig
CONFIG_IDF_TARGET="esp32s3"
CONFIG_ESP_DEFAULT_CPU_FREQ_MHZ_240=y
CONFIG_FREERTOS_HZ=1000
CONFIG_ESPTOOLPY_FLASHMODE_QIO=y
CONFIG_ESPTOOLPY_FLASHFREQ_80M=y
CONFIG_ESPTOOLPY_FLASHSIZE_16MB=y
CONFIG_SPIRAM=y
CONFIG_SPIRAM_MODE_OCT=y
CONFIG_SPIRAM_SPEED_80M=y
CONFIG_SPIRAM_USE_MALLOC=y
CONFIG_SPIRAM_MALLOC_ALWAYSINTERNAL=0
CONFIG_SPIRAM_TRY_ALLOCATE_WIFI_LWIP=y
CONFIG_SPIRAM_MALLOC_RESERVE_INTERNAL=65536
CONFIG_SPIRAM_ALLOW_BSS_SEG_EXTERNAL_MEMORY=y
CONFIG_ESP_WIFI_STATIC_RX_BUFFER_NUM=8
CONFIG_ESP_WIFI_STATIC_TX_BUFFER=y
CONFIG_ESP_WIFI_STATIC_TX_BUFFER_NUM=6
CONFIG_ESP_WIFI_RX_BA_WIN=6
# CONFIG_ESP_WIFI_SOFTAP_SUPPORT is not set
# CONFIG_ESP_WIFI_ENTERPRISE_SUPPORT is not set
# CONFIG_LWIP_DHCPS is not set
CONFIG_MBEDTLS_EXTERNAL_MEM_ALLOC=y
CONFIG_NVS_ALLOCATE_CACHE_IN_SPIRAM=y
CONFIG_FATFS_LFN_HEAP=y
CONFIG_FATFS_MAX_LFN=255
CONFIG_PARTITION_TABLE_CUSTOM=y
CONFIG_PARTITION_TABLE_CUSTOM_FILENAME="partitions.csv"
CONFIG_ESP_CONSOLE_USB_SERIAL_JTAG=y
CONFIG_ESP_CONSOLE_SECONDARY_NONE=y
CONFIG_USB_HOST_CONTROL_TRANSFER_MAX_SIZE=4096
CONFIG_USB_HOST_HW_BUFFER_BIAS_IN=y
CONFIG_USB_HOST_DEBOUNCE_DELAY_MS=500
CONFIG_USB_HOST_RESET_HOLD_MS=100
CONFIG_USB_HOST_RESET_RECOVERY_MS=500
CONFIG_USB_HOST_SET_ADDR_RECOVERY_MS=50
# CONFIG_UVC_CHECK_PAYLOAD_HEADER_EOH is not set
CONFIG_LV_COLOR_DEPTH_1=y
CONFIG_LV_USE_CLIB_MALLOC=y
CONFIG_LV_OS_NONE=y
CONFIG_LV_DRAW_BUF_STRIDE_ALIGN=1
CONFIG_LV_FONT_MONTSERRAT_20=y
CONFIG_LV_FONT_MONTSERRAT_28=y
CONFIG_LV_FONT_MONTSERRAT_48=y
CONFIG_LV_FONT_DEFAULT_MONTSERRAT_20=y
# CONFIG_LV_BUILD_EXAMPLES is not set
# CONFIG_LV_BUILD_DEMOS is not set
# CONFIG_LV_USE_IME_PINYIN is not set
CONFIG_LV_USE_TINY_TTF=y
CONFIG_LV_USE_LODEPNG=y
CONFIG_FATFS_API_ENCODING_UTF_8=y
```
